#ifndef LCD5510_H_
#define LCD5510_H_
#include<delay.h>
#include<Config.h>

sbit RST = P2^7;
sbit SCE = P2^6;
sbit DC= P2^5;
sbit SDIN = P2^4;
sbit SCLK = P2^3;
uchar index[10]={0,1,2,3,4,5,6,7,8,9};
uchar str[10];
const char code characters[]={
		0x00, 0x3E, 0x51, 0x49, 0x45, 0x3E ,/*"0",0*/
		0x00, 0x00, 0x42, 0x7F, 0x40, 0x00 ,/*"1",1*/
		0x00, 0x42, 0x61, 0x51, 0x49, 0x46 ,/*"2",2*/
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		0xff, 0xff, 0xff, 0xff, 0xff, 0xff };/*12*/
const char code characters16_16[]= 
{
0x04,0x84,0xE4,0x5C,0x44,0xC4,0x20,0x10,0xE8,0x27,0x24,0xE4,0x34,0x2C,0xE0,0x00,
0x02,0x01,0x7F,0x10,0x10,0x3F,0x80,0x60,0x1F,0x09,0x09,0x3F,0x49,0x89,0x7F,0x00,/*"ȷ",0*/
0x10,0x0C,0x44,0x44,0x44,0x44,0x45,0xC6,0x44,0x44,0x44,0x44,0x44,0x14,0x0C,0x00,
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0x04,0x04,0x02,0x0A,0x09,0x29,0x2A,0x4C,0x48,0xA9,0x19,0x02,0x02,0x04,0x04,0x00};/*"��",9*/

void lcdDC(uchar dt,uchar command)
{
	uchar i = 0;
	SCE = 0;
	if(command == 0)
		DC = 0;
	else DC = 1;
	for(i;i<8;i++)
	{
		if(dt & 0x80)
			SDIN = 1;
		else
			SDIN = 0;
		SCLK = 0;
		dt = dt << 1;
		SCLK = 1;
	}
	SCE = 1;
}
void lcdClear(void)
{
	uchar t = 0,k = 0;
	lcdDC(0x0C,0);
	lcdDC(0x80,0);
	for(t = 0;t < 6;t ++)
	{
		for(k = 0;k < 84;k ++)
		{
			lcdDC(0x00,1);
		}
	}
}
void lcd5110Init(void)
{
	RST = 0;
	Delaynms(1);
	RST = 1;
	SCE = 0;
	Delaynms(1);
	SCE = 1;
	Delaynms(1);
	lcdDC(0x21,0);//初始化Lcd,功能设定使用扩充指令		
	lcdDC(0xC8,0);//设定液晶偏置电压					
	lcdDC(0x06,0);//温度校正							
    lcdDC(0x13,0);;//设置偏置系统(BSx) 1:48,设置为0x10~0x17 	
	lcdDC(0x20,0);//使用基本指令，V=0，水平寻址			
    lcdClear();
	lcdDC(0x0C,0);//设定显示模式，正常显示				
	SCE = 0;
	Delaynms(200);
}
void lcdSetXY(uchar X,uchar Y)
{
	lcdDC(0x40 | Y,0);
	lcdDC(0x80 | X,0);
}
void lcdWriteChar6_8(uchar row,uchar page,uchar character)	 //row : 0~13  page :0~5 
{
	uchar i = 0;
	lcdSetXY(row * 6,page);
	for(i = 0;i < 6; i ++)
	{
		lcdDC(characters[character * 6 + i],1);
	}
}
void lcdWriteChar16_16(uchar row,uchar page,uchar character)	 //row : 0~13  page :0~5 
{
	uchar i = 0;
	lcdSetXY(row * 16,page);
	for(i = 0;i < 16; i ++)
		lcdDC(characters16_16[character * 32 + i], 1);
	lcdSetXY(row * 16,page + 1);
	for(i = 16;i < 32; i ++)
		lcdDC(characters16_16[character * 32 + i], 1);
}
void lcdClearAny(uchar page,uchar Row_S,uchar Row_E)
{
	uchar i;
	lcdSetXY(6*Row_S,page);
	for(i=0;i<6*(Row_E-Row_S);i++)
		lcdDC(0x00,1);
}
void lcdShowDouble(uchar page,uchar row,double y,uchar n) //nΪ��ʾС����λ��
{
    uint a[10],b,multi;
	uchar i=0,j,f,flag=0,sign=0;
	double x=y;
	unsigned long int w;
	if(x<0) {x=-x,sign=0;}
	else sign=1;
	switch(n)
	{case 0:multi=1;break;
	case 1:multi=10;break;
	case 2:multi=100;break;
	case 3:multi=1000;break;}
	w=(unsigned long int)(x*multi);
	while(1)
	{
		b=w/10;
		i++;
		if(b==0)break;
		w=w/10;
	}
	w=(long int)(x*multi);
	if(w<1000&&n!=0) i=4;
	j=i;
	while(i)
	{
		a[i-1]=w%10;
		w=w/10;
		i--;
	}
	w=(long int)(x*multi);
	if(sign==0)lcdWriteChar6_8(row-1,page,11);
if(w!=0)
	while(i!=j)
	{
		if(flag==0)f=0;else f=1;
		lcdWriteChar6_8(row+i+f,page,a[i]);
		i++;
		if(n!=0)
		{if(i==j-n){flag=1;lcdWriteChar6_8(row+i,page,10);}}
	}
else {lcdClearAny(page,row,row+i);lcdWriteChar6_8(row+i,page,0);}
} 
#endif